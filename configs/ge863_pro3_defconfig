## configs/ge863_pro3_defconfig
```kconfig
BR2_arm=y
BR2_arm926t=y
BR2_TOOLCHAIN_EXTERNAL=y
BR2_PACKAGE_BUSYBOX_WATCHDOG=y
BR2_TARGET_ROOTFS_UBIFS=y
BR2_TARGET_ROOTFS_UBI=y
BR2_TARGET_BAREBOX=y
BR2_TARGET_BAREBOX_2011_09=y
BR2_TARGET_BAREBOX_CUSTOM_PATCH_DIR="board/telit/ge863-pro3/barebox-2011.09.0-patches"
BR2_TARGET_BAREBOX_BOARD_DEFCONFIG="telit_ge863_pro3"
BR2_LINUX_KERNEL=y
BR2_LINUX_KERNEL_CUSTOM_VERSION=y
BR2_LINUX_KERNEL_CUSTOM_VERSION_VALUE="3.6.2"
BR2_LINUX_KERNEL_PATCH="board/telit/ge863-pro3/linux-3.6-patches"
BR2_LINUX_KERNEL_DEFCONFIG="at91_dt"
BR2_LINUX_KERNEL_APPENDED_UIMAGE=y
BR2_LINUX_KERNEL_INTREE_DTS_NAME="evk-pro3"
```
